## examples/esp32-firmware-upload-ota-example/sdkconfig.defaults
```kconfig
CONFIG_ESPTOOLPY_FLASHSIZE_4MB=y
CONFIG_ESPTOOLPY_FLASHMODE_QIO=y
CONFIG_ESPTOOLPY_FLASHFREQ_80M=y
CONFIG_ESP_DEFAULT_CPU_FREQ_MHZ_240=y

CONFIG_BOOTLOADER_LOG_LEVEL_WARN=y
CONFIG_LOG_DEFAULT_LEVEL_INFO=y

CONFIG_COMPILER_OPTIMIZATION_PERF=y

CONFIG_PARTITION_TABLE_CUSTOM=y

CONFIG_ETH_ENABLED=n
CONFIG_ETH_USE_SPI_ETHERNET=n

CONFIG_ESP_WIFI_NVS_ENABLED=y

CONFIG_LWIP_IPV6_AUTOCONFIG=y
CONFIG_LWIP_LOCAL_HOSTNAME="esp32-firmware-upload-ota-example"
```
